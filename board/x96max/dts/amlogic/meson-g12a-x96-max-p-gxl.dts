// SPDX-License-Identifier: (GPL-2.0+ OR MIT)
// Unit 3: drive the USB glue as GXL instead of G12A.
//
// The board's vendor device tree reports cpu-type = "gxl" on the dwc3 node, and
// vendor dmesg shows their USB2 PHY driver initialising 0xffe09000:
//
//   amlogic-new-usb2-v2 ffe09000.usb2phy: USB2 phy probe:phy_mem:0xffe09000
//
// In mainline the two driver variants interpret the glue base differently:
//
//   G12A: glue regmap = base + 0x80, and a u2p regmap per PHY at base + i*0x20
//   GXL : glue regmap = base,        and no u2p regmap at all
//
// With the G12A binding the driver writes 0xffe09000/0xffe09010 (u2p) and
// 0xffe09084 (USB_R1) and faults with a synchronous external abort, because on
// this board 0xffe09000 belongs to the USB2 PHY, not to the glue block.
// Selecting the GXL variant removes both the u2p registers and the 0x80 offset,
// which matches where the vendor blocks actually sit.
//
// gxl_drvdata asks for clocks named "usb_ctrl" and "ddr" (meson_gxl_clocks).
// Note num_clks is mistakenly ARRAY_SIZE(meson_g12a_clocks), so only the first
// entry, "usb_ctrl", is actually requested; supplying just that one is enough.
#include "meson-g12a-x96-max-p-ephy.dts"
#include <dt-bindings/clock/g12a-clkc.h>

&usb {
	compatible = "amlogic,meson-gxl-usb-ctrl";
	/*
	 * The G12A common dtsi gives the glue a single unnamed clock. GXL asks
	 * for it by name, so name it here.
	 */
	clocks = <&clkc CLKID_USB>;
	clock-names = "usb_ctrl";
	/*
	 * Vendor firmware reports hcc_params 0x0228fe6c (HCC_PPC = 1) while
	 * mainline reports 0x0228fe64 (HCC_PPC = 0): the GXL glue variant never
	 * runs usb3_init(), so the glue's PORT_POWER_CONTROL_PRESENT bit stays
	 * clear. With PPC = 0 xhci advertises "port power always on" and never
	 * drives PP, so a plugged device is never brought up. Opt in to the
	 * xhci patch that raises PPC without touching the glue register.
	 */
	amlogic,port-power-control;
	/*
	 * This board's 0xffe09000 is the USB2 PHY control area, so every G12A
	 * glue write faults (USB_R1 via regmap_update_bits, and the u2p
	 * regmaps). Skip the glue sequence entirely; the PHYs are still set up
	 * by their own driver through this node's phy list.
	 */
	amlogic,skip-glue-init;
};

/*
 * The vendor block at 0xff400000 is not usable here: dwc2 probes the USB2 PHY
 * through a register window that faults on this board (synchronous external
 * abort in dwc2_driver_probe). Nothing needs it, because the DT295 is driven by
 * the dwc3 host controller above.
 */
&dwc2 {
	status = "disabled";
};

/*
 * dwc3 itself needs the USB gate clock and the USB reset.
 *
 * The GXL glue node holds both, and the child inherits neither: dwc3_probe's
 * reset_control_deassert() and dwc3_clk_enable() then succeed as no-ops, and
 * dwc3_core_is_valid() reads 0xff500020 while the controller is still gated,
 * which is the synchronous external abort (pc: dwc3_core_probe+0x96c).
 */
&dwc3 {
	clocks = <&clkc CLKID_USB>;
	resets = <&reset RESET_USB>;
};
