## Config.in
```kconfig
source "$BR2_EXTERNAL_X96MAX_PATH/package/torne/Config.in"
source "$BR2_EXTERNAL_X96MAX_PATH/package/pix-tuner/Config.in"
source "$BR2_EXTERNAL_X96MAX_PATH/package/meson-venc/Config.in"
source "$BR2_EXTERNAL_X96MAX_PATH/package/siano-ts/Config.in"
source "$BR2_EXTERNAL_X96MAX_PATH/package/bcasd/Config.in"
source "$BR2_EXTERNAL_X96MAX_PATH/package/cardrelay/Config.in"
source "$BR2_EXTERNAL_X96MAX_PATH/package/stb-streamer/Config.in"
source "$BR2_EXTERNAL_X96MAX_PATH/package/cfw/Config.in"
```

## configs/x96max_defconfig
```kconfig
BR2_aarch64=y
BR2_cortex_a53=y
BR2_TOOLCHAIN_BUILDROOT_GLIBC=y
BR2_TOOLCHAIN_BUILDROOT_CXX=y
BR2_KERNEL_HEADERS_AS_KERNEL=y
BR2_PACKAGE_HOST_LINUX_HEADERS_CUSTOM_6_18=y
BR2_TARGET_GENERIC_HOSTNAME="x96max-linux"
BR2_TARGET_GENERIC_ISSUE="X96Max_P Linux bring-up"
BR2_TARGET_GENERIC_GETTY_PORT="ttyAML0"
BR2_TARGET_GENERIC_GETTY_BAUDRATE_115200=y
BR2_SYSTEM_DHCP="eth0"
BR2_ROOTFS_OVERLAY="$(BR2_EXTERNAL_X96MAX_PATH)/board/x96max/overlay"
BR2_ROOTFS_POST_IMAGE_SCRIPT="$(BR2_EXTERNAL_X96MAX_PATH)/board/x96max/post-image.sh"
BR2_LINUX_KERNEL=y
BR2_GLOBAL_PATCH_DIR="$(BR2_EXTERNAL_X96MAX_PATH)/board/x96max/patches"
BR2_LINUX_KERNEL_CUSTOM_VERSION=y
BR2_LINUX_KERNEL_CUSTOM_VERSION_VALUE="6.18.62"
BR2_LINUX_KERNEL_USE_ARCH_DEFAULT_CONFIG=y
BR2_LINUX_KERNEL_CONFIG_FRAGMENT_FILES="$(BR2_EXTERNAL_X96MAX_PATH)/board/x96max/linux.fragment"
BR2_LINUX_KERNEL_DTS_SUPPORT=y
BR2_LINUX_KERNEL_CUSTOM_DTS_DIR="$(BR2_EXTERNAL_X96MAX_PATH)/board/x96max/dts"
BR2_LINUX_KERNEL_INTREE_DTS_NAME="amlogic/meson-g12a-x96-max-p amlogic/meson-g12a-x96-max-p-ephy"
BR2_LINUX_KERNEL_NEEDS_HOST_OPENSSL=y
BR2_PACKAGE_LIBUSB=y
BR2_PACKAGE_LIBUDEV_ZERO=y
BR2_PACKAGE_USBUTILS=y
BR2_PACKAGE_DROPBEAR=y
BR2_PACKAGE_TORNE=y
BR2_PACKAGE_PIX_TUNER=y
BR2_PACKAGE_CARDRELAY=y
BR2_PACKAGE_STB_STREAMER=y
BR2_PACKAGE_SIANO_TS=y
BR2_PACKAGE_BCASD=y
BR2_PACKAGE_CCID=y
BR2_PACKAGE_PCSC_LITE=y
BR2_PACKAGE_PCSC_LITE_FORCE_LIBUSB=y
BR2_PACKAGE_MESON_VENC=y
BR2_PACKAGE_FFMPEG=y
BR2_PACKAGE_FFMPEG_FFMPEG=y
BR2_PACKAGE_FFMPEG_FFPROBE=y
BR2_PACKAGE_FFMPEG_SWSCALE=y
BR2_TARGET_ROOTFS_EXT2=y
BR2_TARGET_ROOTFS_EXT2_4=y
BR2_TARGET_ROOTFS_EXT2_SIZE="512M"
BR2_TARGET_ROOTFS_EXT2_LABEL="x96-root"
# BR2_TARGET_ROOTFS_TAR is not set
BR2_PACKAGE_HOST_GENIMAGE=y
BR2_PACKAGE_HOST_DOSFSTOOLS=y
BR2_PACKAGE_HOST_MTOOLS=y
```

## package/bcasd/Config.in
```kconfig
config BR2_PACKAGE_BCASD
	bool "bcasd (B-CAS APDU server)"
	depends on BR2_TOOLCHAIN_HAS_THREADS
	select BR2_PACKAGE_PCSC_LITE
	help
	  Multi-client B-CAS APDU server for PC/SC card readers. Clients
	  speak the 524-byte TorneCardMessage frame over TCP, which
	  torne-b25 reaches through cardrelay.
```

## package/cardrelay/Config.in
```kconfig
config BR2_PACKAGE_CARDRELAY
	bool "cardrelay (local card socket to remote bcasd)"
	help
	  Bridges the UNIX socket that torne-b25 opens to a remote bcasd
	  over TCP. torne-b25 speaks the 524-byte frame protocol on
	  /dev/shm/torne/card.sock; this relay forwards those frames.
```

## package/cfw/Config.in
```kconfig
config BR2_PACKAGE_CFW
	bool "cfw (MB8AC031 replacement firmware tools for PIX-DT295)"
	select BR2_PACKAGE_LIBUSB
	help
	  Host-side tools for MB8AC031-CFW: frc1_load puts the replacement
	  firmware on the tuner chip, and ts_grab takes the raw (still
	  scrambled) transport stream out of it.

	  The firmware itself (frc1-dt295.frc) is installed alongside, so the
	  image carries the exact container the tools were built against.

	  This is the DT295 path that replaces in-tuner descrambling: the
	  tuner hands over the stream before it is decrypted, and torne-b25
	  does the ARIB MULTI2 work with a B-CAS card.
```

## package/meson-venc/Config.in
```kconfig
config BR2_PACKAGE_MESON_VENC
	bool "meson H.264 hardware encoder (amvenc_avc)"
	depends on BR2_LINUX_KERNEL
	help
	  Amlogic HCodec H.264 encoder exposed as a V4L2 mem2mem device
	  (/dev/video1). Ported from meson-sm1-codecs and switched to the
	  G12A platform. The ucode is expected at
	  /lib/firmware/meson/venc/ga_h264_enc_cabac.bin.
```

## package/pix-tuner/Config.in
```kconfig
config BR2_PACKAGE_PIX_TUNER
	bool "pix-ts-legacy (PIX-DT295)"
	depends on BR2_TOOLCHAIN_HAS_THREADS
	select BR2_PACKAGE_LIBUSB
	help
	  dtv_android's PIX-DT295 CLI and transcoder hooks, rebuilt for Linux.
```

## package/siano-ts/Config.in
```kconfig
config BR2_PACKAGE_SIANO_TS
	bool "siano-ts (PX-S1UD ISDB-T tuner)"
	select BR2_PACKAGE_LIBUSB
	help
	  User-space ISDB-T driver for Siano RIO based USB tuners
	  (PLEX PX-S1UD 3275:0080). Based on Khronos31/siano-userland.
```

## package/stb-streamer/Config.in
```kconfig
config BR2_PACKAGE_STB_STREAMER
	bool "stb-streamer (fMP4 spool and HTTP server)"
	depends on BR2_TOOLCHAIN_HAS_THREADS
	help
	  Reads fragmented MP4 from standard input, keeps it in a bounded
	  RAM spool and serves it over the same HTTP protocol as the
	  Android build (GET /v1/streams/<channel>, GET /v1/status,
	  POST /v1/stop). The NAS pulls from this endpoint.
```

## package/torne/Config.in
```kconfig
config BR2_PACKAGE_TORNE
	bool "torne-c and torne-b25"
	depends on BR2_INSTALL_LIBSTDCPP
	depends on BR2_TOOLCHAIN_HAS_THREADS
	select BR2_PACKAGE_LIBUSB
	help
	  Existing dtv_android tuner implementation, rebuilt for Linux.
```
